## west.yml
```yaml
manifest:
  remotes:
    - name: zephyrproject
      url-base: https://github.com/zephyrproject-rtos
  projects:
    - name: zephyr
      repo-path: zephyr
      remote: zephyrproject
      revision: e80d86ab853976782a1623529fdb1672cae88307
      import:
        path-prefix: deps
        name-allowlist:
          - cmsis
          - cmsis-dsp
          - percepio
          - picolibc
          - segger
          - hal_nxp
  self:
    path: temp_alert
```
